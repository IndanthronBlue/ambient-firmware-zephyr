## boards/st/stm32l496g_bird/Kconfig.stm32l496g_bird
```kconfig
# Copyright (c) 2019 Centaur Analytics, Inc
# SPDX-License-Identifier: Apache-2.0

config BOARD_STM32L496G_BIRD
	select SOC_STM32L496XX
```

## boards/st/stm32u5_bird/Kconfig.defconfig
```kconfig
# STM32U5 Bird board configuration

# Copyright (c) 2016 Open-RnD Sp. z o.o.
# Copyright (c) 2016 BayLibre, SAS
# SPDX-License-Identifier: Apache-2.0

if BOARD_STM32U5_BIRD

config SPI_STM32_INTERRUPT
	default y
	depends on SPI

endif # BOARD_STM32U5_BIRD
```

## boards/st/stm32u5_bird/board.yml
```yaml
board:
  name: stm32u5_bird
  full_name: STM32U5 EZBird
  vendor: leat
  socs:
    - name: stm32u595xx
```

## stm32l496g_bird/board.yml
```yaml
board:
  name: stm32l496g_bird
  full_name: STM32L496G EZBird
  vendor: leat
  socs:
    - name: stm32l496xx
```

## stm32u5_bird/Kconfig.stm32u5_bird
```kconfig
# Copyright (c) 2019 Centaur Analytics, Inc
# SPDX-License-Identifier: Apache-2.0

config BOARD_STM32U5_BIRD
	select SOC_STM32U595XX
```

## stm32u5_bird/stm32u5_bird_defconfig
```kconfig
CONFIG_REGULATOR=y

# enable uart driver
CONFIG_SERIAL=y

# enable GPIO
CONFIG_GPIO=y

# enable clocks
CONFIG_CLOCK_CONTROL=y

# console
CONFIG_CONSOLE=y
CONFIG_UART_CONSOLE=y

# enable pin controller
CONFIG_PINCTRL=y

# USB
CONFIG_USB_DEVICE_STACK=n
CONFIG_USB_COMPOSITE_DEVICE=n
CONFIG_USB_DEVICE_MANUFACTURER="EZbird"
CONFIG_USB_DEVICE_PRODUCT="LEAT"
CONFIG_USB_DEVICE_VID=0x1209
CONFIG_USB_DEVICE_PID=0x6202
CONFIG_USB_SELF_POWERED=n
CONFIG_USB_CDC_ACM=n
CONFIG_USB_DEVICE_INITIALIZE_AT_BOOT=n
```

## west.yml
```yaml
manifest:
  version: "1.2"

  remotes:
    - name: zephyrproject
      url-base: https://github.com/zephyrproject-rtos

  defaults:
    remote: zephyrproject

  group-filter:
    - -babblesim
    - -optional
    - -testing

  projects:
    - name: zephyr
      repo-path: zephyr
      revision: 8dc3c6f3b09019e6ab8b390e04d3edc93ccafd63
      import: true

  self:
    path: git/ambient-firmware-zephyr
```
